## components/cc1101/Kconfig.projbuild
```kconfig
menu "CC1101 Configuration"

    config CC_LOG_LEVEL
        int "CC LOG LEVEL"
        range 0	5
        default 0
        help
        	Set LOG Level for CC1101 module
        	0=None
        	1=Error
        	2=Warn
        	3=Info
        	4=Debug
        	5=Verbose
        	
	config CC_GPIO_RANGE_MAX
		int
		default 48 if IDF_TARGET_ESP32S3

	config CC_MOSI_GPIO
		int "CC1101 MOSI GPIO"
		range 0 CC_GPIO_RANGE_MAX
		default 35 if IDF_TARGET_ESP32S3
		help
			Pin Number to be used as the MOSI SPI signal.

	config CC_SCK_GPIO
		int "CC1101 SCK GPIO"
		range 0 CC_GPIO_RANGE_MAX
		default 36 if IDF_TARGET_ESP32S3
		help
			Pin Number to be used as the SCK SPI signal.

	config CC_MISO_GPIO
		int "CC1101 MISO GPIO"
		range 0 CC_GPIO_RANGE_MAX
		default 37 if IDF_TARGET_ESP32S3
		help
			Pin Number to be used as the MISO SPI signal.

	config CC_CSN_GPIO
		int "CC1101 CSN GPIO"
		range 0 CC_GPIO_RANGE_MAX
		default 38 if IDF_TARGET_ESP32S3
		help
			Pin Number to be used as the CSN SPI signal.

	config CC_GDO0_GPIO
		int "CC1101 GDO0 GPIO"
		range 0 CC_GPIO_RANGE_MAX
		default 39 if IDF_TARGET_ESP32S3
		help
			Pin Number to be used as the GDO0 signal.

	config CC_GDO2_GPIO
		int "CC1101 GDO2 GPIO"
		range 0 CC_GPIO_RANGE_MAX
		default 40 if IDF_TARGET_ESP32S3
		help
			Pin Number to be used as the GDO0 signal.

	choice SPI_HOST
		prompt "SPI peripheral that controls this bus"
		default CC_SPI2_HOST
		help
			Select SPI peripheral that controls this bus.
		config CC_SPI2_HOST
			bool "CC_SPI2_HOST"
			help
				Use SPI2_HOST. This is also called HSPI_HOST.
		config CC_SPI3_HOST
			depends on IDF_TARGET_ESP32S3
			bool "CC_SPI3_HOST"
			help
				USE SPI3_HOST. This is also called VSPI_HOST
	endchoice

endmenu
```

## components/frame/Kconfig.projbuild
```kconfig
menu "Frame Configuration"

    config FRM_LOG_LEVEL
        int "Frame LOG LEVEL"
        range 0	5
        default 2
        help
        	Set LOG Level for FRAME module
        	0=None
        	1=Error
        	2=Warn
        	3=Info
        	4=Debug
        	5=Verbose

    config FRM_MIN_TX_DELAY
        int "Minimum delay before TX (mS)"
        range 0 100
        default	50
        help
            Specifies the minimum delay after any RX or TX frame before next TX

    config FRM_MAX_CAL_INTERVAL
        int "Maximum interval between cc1101 calibrations (sec)"
        range 0 300
        default	30
        help
            Specifies the maximum interval between cc1101 calibrations

    config UART_LOG_LEVEL
        int "UART LOG LEVEL"
        range 0	5
        default 2
        help
        	Set LOG Level for UART module
        	0=None
        	1=Error
        	2=Warn
        	3=Info
        	4=Debug
        	5=Verbose

endmenu
```

## components/gateway/Kconfig.projbuild
```kconfig
menu "Gateway Configuration"

    config GWAY_LOG_LEVEL
        int "Gateway LOG LEVEL"
        range 0	5
        default 2
        help
        	Set LOG Level for GATEWAY module
        	0=None
        	1=Error
        	2=Warn
        	3=Info
        	4=Debug
        	5=Verbose

endmenu
```

## components/message/Kconfig.projbuild
```kconfig
menu "Message Configuration"

    config MSG_LOG_LEVEL
        int "Message LOG LEVEL"
        range 0	5
        default 2
        help
        	Set LOG Level for MESSAGE module
        	0=None
        	1=Error
        	2=Warn
        	3=Info
        	4=Debug
        	5=Verbose

    config N_MSG
        int "Pre-allocated messages"
        range 0 16
        default 16
        help
            Number of allocated messages.
    
endmenu
```

## components/ramses-debug/Kconfig.projbuild
```kconfig
menu "Debug Configuration"

    config DEBUG_PIN1
        int "Debug pin 1"
        range 0	11
        default 6
        help
        	Debug Pin 1 GPIO
        	0=Disable
        	6-11=GPIO

    config DEBUG_PIN2
        int "Debug pin 2"
        range 0	11
        default 7
        help
        	Debug Pin 2 GPIO
        	0=Disable
        	6-11=GPIO
        	
    config DEBUG_PIN3
        int "Debug pin 3"
        range 0	11
        default 8
        help
        	Debug Pin 3 GPIO
        	0=Disable
        	6-11=GPIO

    config DEBUG_PIN4
        int "Debug pin 4"
        range 0	11
        default 9
        help
        	Debug Pin 1 GPIO
        	0=Disable
        	6-11=GPIO

    config DEBUG_PIN5
        int "Debug pin 5"
        range 0	12 
        default 10
        help
        	Debug Pin 5 GPIO
        	0=Disable
        	6-11=GPIO

    config DEBUG_PIN6
        int "Debug pin 6"
        range 0	11
        default 11
        help
        	Debug Pin 6 GPIO
        	0=Disable
        	6-11=GPIO

endmenu
```

## components/ramses-led/Kconfig.projbuild
```kconfig
menu "LED Configuration"

	config GPIO_RX_LED
		int "RX LED GPIO"
		default 42
        help
        	GPIOx for RX LED

	config GPIO_TX_LED
		int "TX LED GPIO"
		default 41
        help
        	GPIOx for TX LED
  		
endmenu
```

## components/ramses-mqtt/Kconfig.projbuild
```kconfig
menu "MQTT Configuration"

    config MQTT_LOG_LEVEL
        int "MQTT LOG LEVEL"
        range 0	5
        default 2
        help
        	Set LOG Level for MQTT module
        	0=None
        	1=Error
        	2=Warn
        	3=Info
        	4=Debug
        	5=Verbose
        	
    
    config MQTT_ROOT
        string "MQTT Root topic"
        default "RAMSES/GATEWAY"
        help
          "Root topic for RAMSES Gateway devices"

endmenu
```

## components/ramses-nvs/Kconfig.projbuild
```kconfig
menu "NVS Configuration"

    config NVS_LOG_LEVEL
        int "NVS LOG LEVEL"
        range 0	5
        default 2
        help
        	Set LOG Level for NVS Management
        	0=None
        	1=Error
        	2=Warn
        	3=Info
        	4=Debug
        	5=Verbose

endmenu
```

## main/Kconfig.projbuild
```kconfig
# put here your custom config value
menu "RAMSES_ESP configuration"

    config RADIO_CORE
    int "Core for Radio Task"
        range 0 1
        default 1
        help
            The Radio task will run on this core.

    config HOST_CORE
    int "Core for Host Task"
        range 0 1
        default 0
        help
            The Host task will run on this core.

    config FUNCTION_PIN
    int "Function Button GPIO pin"
      range 0 41
      default 0
      help
          GPIO pin number of Function Button          

    config CS_PLATFORM_PIN
    int "CS Pin"
      range 0 41
      default 12
        help
        	GPIOx for CS Platform

    config RESTART_DELAY
    int "Restart Delay"
      range 10 30
      default 15
        help
        	FUNC button hold fore restart (Sec)

endmenu
```

## sdkconfig.defaults
```kconfig
# Minimum FLASH size
CONFIG_ESPTOOLPY_FLASHSIZE_8MB=y
CONFIG_PARTITION_TABLE_CUSTOM=y
CONFIG_PARTITION_TABLE_CUSTOM_FILENAME="partitions.csv"

# Use Built in USB CDC Serial
CONFIG_ESP_CONSOLE_USB_SERIAL_JTAG=y
CONFIG_ESP_CONSOLE_SECONDARY_NONE=y
CONFIG_ESP_CONSOLE_UART_NUM=-1

# netif name
CONFIG_LWIP_LOCAL_HOSTNAME="ramses_esp"

# Allow Open WIFI networks
CONFIG_WIFI_AUTH_OPEN=y

# Lock system tasks to Core 0
CONFIG_LWIP_TCPIP_TASK_AFFINITY_CPU0=y
CONFIG_LWIP_TCPIP_TASK_AFFINITY=0x0
CONFIG_TCPIP_TASK_AFFINITY_CPU0=y
CONFIG_TCPIP_TASK_AFFINITY=0x0
CONFIG_MQTT_TASK_CORE_SELECTION_ENABLED=y
CONFIG_MQTT_USE_CORE_0=y

# Log configuration
CONFIG_LOG_COLORS=n

# Suppress bootloader log output
CONFIG_BOOTLOADER_LOG_LEVEL_NONE=y
CONFIG_BOOTLOADER_LOG_LEVEL=0

# Suppress all log output by default but prepare for CLI control
CONFIG_LOG_DEFAULT_LEVEL_NONE=y
CONFIG_LOG_DEFAULT_LEVEL=0
CONFIG_LOG_MAXIMUM_LEVEL_VERBOSE=y
CONFIG_LOG_MAXIMUM_LEVEL=5
CONFIG_LOG_MASTER_LEVEL=y
```
